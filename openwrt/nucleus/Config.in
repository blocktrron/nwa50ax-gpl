## openwrt/nucleus/Config.in
```kconfig
config KERNEL_ZYUMAC_SUPPORT
	bool

config KERNEL_ZYUMAC_BOARD_TYPE
	hex "BOARD_TYPE for different boards"
	default 0
	help
		This option could be used for boardtype hex value

menuconfig ZYUMAC_SUPPORT
	bool  "Zyxel Board Profile Setting"
	select KERNEL_ZYUMAC_SUPPORT

if ZYUMAC_SUPPORT

        config ZYUMAC_BOARD_NAME
                string "Enter Zyxel board name"
                default ""

        config ZYUMAC_MODEL_NAME
                string "Enter Zyxel model name"
                default ""
endif

if TARGET_ramips

		config KERNEL_ZYUMAC_VER
				string "Enter wlan driver version"
				default "6.0"

endif
```

## u-boot-mips-mt7621/configs/mt7621_nand_ax_rfb_defconfig
```kconfig
CONFIG_MIPS=y
CONFIG_SPL_LDSCRIPT="arch/$(ARCH)/mach-mt7621/spl/u-boot-nand-spl.lds"
CONFIG_SPL_SERIAL_SUPPORT=y
CONFIG_ENV_SIZE=0x20000
CONFIG_ENV_OFFSET=0x80000
CONFIG_SPL_SYS_MALLOC_F_LEN=0x100000
CONFIG_DEBUG_UART_BOARD_INIT=y
CONFIG_DEBUG_UART_BASE=0xbe000c00
CONFIG_DEBUG_UART_CLOCK=50000000
CONFIG_MACH_MT7621=y
CONFIG_BOARD_MT7621_NAND_RFB=y
CONFIG_MT7621_LEGACY_DRAMC_BIN=y
# CONFIG_MT7621_DRAMC_DEBUG_LEGACY is not set
CONFIG_ENABLE_NAND_NMBM=y
CONFIG_DEFAULT_NAND_KERNEL_OFFSET=0x180000
CONFIG_MIPS_BOOT_FDT=y
CONFIG_DEBUG_UART=y
CONFIG_ZYXEL_VERSION="V1.05"
CONFIG_NR_DRAM_BANKS=1
# CONFIG_EXPERT is not set
CONFIG_FIT=y
# CONFIG_ARCH_FIXUP_FDT_MEMORY is not set
CONFIG_NAND_BOOT=y
CONFIG_BOOTDELAY=1
CONFIG_USE_BOOTARGS=y
CONFIG_BOOTARGS="console=ttyS0,115200 loglevel=1"
CONFIG_USE_BOOTCOMMAND=y
CONFIG_BOOTCOMMAND="atgo"
CONFIG_SYS_STDIO_DEREGISTER=y
CONFIG_DISPLAY_CPUINFO=y
CONFIG_LAST_STAGE_INIT=y
CONFIG_SPL_NAND_SUPPORT=y
CONFIG_SPL_PAYLOAD="u-boot-lzma.img"
CONFIG_SPL_YMODEM_SUPPORT=y
CONFIG_HUSH_PARSER=y
CONFIG_CMD_BOOTMENU=y
# CONFIG_CMD_ELF is not set
# CONFIG_CMD_FLASH is not set
CONFIG_CMD_GPIO=y
CONFIG_CMD_NMBM=y
# CONFIG_CMD_NFS is not set
CONFIG_CMD_MTDPARTS=y
CONFIG_MTDIDS_DEFAULT="nmbm0=nmbm0"
CONFIG_MTDPARTS_DEFAULT="mtdparts=nmbm0:512k(u-boot),512k(u-boot-env),512k(factory),40m(firmware),40m(firmware_1),20m(rootfs_data),13m(logs),4608k(myzyxel),512k(bootconfig),512k(mrd)"
# CONFIG_PARTITIONS is not set
CONFIG_OF_CONTROL=y
CONFIG_OF_EMBED=y
CONFIG_DEFAULT_DEVICE_TREE="mt7621_nand_rfb"
CONFIG_ENV_IS_IN_NMBM=y
CONFIG_ENV_SECT_SIZE=0x20000
CONFIG_NET_RANDOM_ETHADDR=y
# CONFIG_DM_WARN is not set
# CONFIG_OF_TRANSLATE is not set
CONFIG_DM_GPIO=y
CONFIG_MT7621_GPIO=y
CONFIG_MTD=y
CONFIG_MTD_PARTITIONS=y
CONFIG_NAND_MT7621=y
CONFIG_SPL_NAND_BASE_SIMPLE=y
CONFIG_DM_ETH=y
CONFIG_MT7621_ETH=y
CONFIG_PINCTRL=y
CONFIG_PINCONF=y
CONFIG_PINCTRL_MT7621=y
CONFIG_DM_RESET=y
CONFIG_MT7621_RESET=y
CONFIG_DM_SERIAL=y
CONFIG_DEBUG_UART_MTK=y
CONFIG_DEBUG_UART_SHIFT=2
CONFIG_MTK_SERIAL=y
CONFIG_LZMA=y
CONFIG_SPL_LZMA=y
```
